&i2c1 {
    status = "okay";
    sda-pin = <2>;  /* P0.02 */
    scl-pin = <3>;  /* P0.03 */
    
    ssd1306@3c {
        compatible = "solomon,ssd1306fb";
        reg = <0x3c>;
        label = "SSD1306";
        width = <128>;
        height = <64>;
        rotation = <180>;
        reset-gpios = <&gpio0 20 GPIO_ACTIVE_LOW>;
    };
};
