## config/west.yml
```yaml
manifest:
  defaults:
    revision: v0.3
  remotes:
    - name: zmkfirmware
      url-base: https://github.com/zmkfirmware
    - name: zzeneg
      url-base: https://github.com/zzeneg
    - name: m165437 #new entry
      url-base: https://github.com/M165437 #new entry
    - name: mctechnology17
      url-base: https://github.com/mctechnology17
  projects:
    - name: zmk
      remote: zmkfirmware
      import: app/west.yml
    - name: zmk-raw-hid
      remote: zzeneg
      revision: main
    - name: nice-view-gem #new entry
      remote: m165437 #new entry
      revision: 7794ebf # pinned: last LVGL v8 compatible commit (v0.3.0)
    - name: zmk-dongle-display-view
      remote: mctechnology17
      revision: main
  self:
    path: config
```
